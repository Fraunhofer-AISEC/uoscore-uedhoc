## CMakeLists.txt
```
# SPDX-License-Identifier: Apache-2.0

cmake_minimum_required(VERSION 3.13.1)
find_package(Zephyr REQUIRED HINTS $ENV{ZEPHYR_BASE})

project(auto_test)

FILE(GLOB app_sources 
  main.c
  edhoc_testvector_tests/*.c 
  oscore_testvector_tests/*.c 
  ../externals/zcbor/src/*.c
  ../externals/compact25519/src/c25519/*.c
  ../externals/compact25519/src/*.c
  ../externals/mbedtls/library/*.c)
target_sources(app PRIVATE ${app_sources})
#../samples/common/cbor/*.c
#../samples/common/test_vec_parser.c

include_directories(
  ../test_vectors
  ../externals/zcbor/include 
  ../externals/mbedtls/library 
  ../externals/mbedtls/include 
  ../externals/mbedtls/include/mbedtls 
  ../externals/mbedtls/include/psa )
#  ../externals/jsmn

add_definitions(
  #-DDEBUG_PRINT
  -DZCBOR_CANONICAL
)

# The external static library that we are linking with does not know
# how to build for this platform so we export all the flags used in
# this zephyr build to the external build system.
zephyr_get_include_directories_for_lang_as_string(       C includes)
zephyr_get_system_include_directories_for_lang_as_string(C system_includes)
zephyr_get_compile_definitions_for_lang_as_string(       C definitions)
zephyr_get_compile_options_for_lang_as_string(           C options)

set(external_project_cflags
  "${includes} ${definitions} ${options} ${system_includes}"
  )

include(ExternalProject)

# Add an external project to be able download and build the third
# party library. In this case downloading is not necessary as it has
# been committed to the repository.
set(src_dir   ${CMAKE_CURRENT_SOURCE_DIR}/..)
set(build_dir ${CMAKE_CURRENT_BINARY_DIR}/uoscore_uedhoc)

set(LIB_TEST_LIB_DIR     ${CMAKE_CURRENT_SOURCE_DIR}/../build)
set(EDHOC_INCLUDE_DIR ${CMAKE_CURRENT_SOURCE_DIR}/../modules/edhoc)
set(OSCORE_INCLUDE_DIR ${CMAKE_CURRENT_SOURCE_DIR}/../modules/oscore)

if(CMAKE_GENERATOR STREQUAL "Unix Makefiles")
# https://www.gnu.org/software/make/manual/html_node/MAKE-Variable.html
set(submake "$(MAKE)")
else() # Obviously no MAKEFLAGS. Let's hope a "make" can be found somewhere.
set(submake "make")
endif()

message("build_dir: ${build_dir}")
message("CMAKE_CURRENT_SOURCE_DIR: ${CMAKE_CURRENT_SOURCE_DIR}")
message("CMAKE_CURRENT_BINARY_DIR: ${CMAKE_CURRENT_BINARY_DIR}")
message("LIB_TEST_LIB_DIR: ${LIB_TEST_LIB_DIR}")
message("EDHOC_INCLUDE_DIR: ${EDHOC_INCLUDE_DIR}")



ExternalProject_Add(
  oscore_edhoc_project                 # Name for custom target
  PREFIX ${build_dir} # Root dir for entire project
  SOURCE_DIR ${src_dir}
  BINARY_DIR ${src_dir} # This particular build system is invoked from the root
  CONFIGURE_COMMAND ""    # Skip configuring the project, e.g. with autoconf
  BUILD_COMMAND
  ${submake}
  PREFIX=${build_dir}
  CC=${CMAKE_C_COMPILER}
  AR=${CMAKE_AR}
  CFLAGS=${external_project_cflags}
  INSTALL_COMMAND ""      # This particular build system has no install command
  BUILD_BYPRODUCTS ${build_dir}/libuoscore-uedhoc.a
  )

# Create a wrapper CMake library that our app can link with
add_library(test STATIC IMPORTED GLOBAL)
add_dependencies(
  test
  oscore_edhoc_project
  )
set_target_properties(test PROPERTIES IMPORTED_LOCATION ${build_dir}/libuoscore-uedhoc.a)
target_include_directories(test INTERFACE
  ${EDHOC_INCLUDE_DIR}
  ${OSCORE_INCLUDE_DIR}
)


target_link_libraries(app PRIVATE test)
```

## prj.conf
```kconfig
CONFIG_ZTEST=y
CONFIG_ZTEST_STACKSIZE=10240
```

## src/main.c
```c
/*
   Copyright (c) 2021 Fraunhofer AISEC. See the COPYRIGHT
   file at the top-level directory of this distribution.

   Licensed under the Apache License, Version 2.0 <LICENSE-APACHE or
   http://www.apache.org/licenses/LICENSE-2.0> or the MIT license
   <LICENSE-MIT or http://opensource.org/licenses/MIT>, at your
   option. This file may not be copied, modified, or distributed
   except according to those terms.
*/

#include <zephyr.h>
#include <ztest.h>
#include "edhoc_tests.h"

static void test_initiator1(void)
{
	test_edhoc(INITIATOR, 1);
}
static void test_initiator2(void)
{
	test_edhoc(INITIATOR, 2);
}
static void test_initiator3(void)
{
	test_edhoc(INITIATOR, 3);
}
static void test_initiator4(void)
{
	test_edhoc(INITIATOR, 4);
}
static void test_initiator8(void)
{
	test_edhoc(INITIATOR, 8);
}
static void test_initiator9(void)
{
	test_edhoc(INITIATOR, 9);
}
static void test_initiator12(void)
{
	test_edhoc(INITIATOR, 12);
}
static void test_initiator13(void)
{
	test_edhoc(INITIATOR, 13);
}

static void test_responder1(void)
{
	test_edhoc(RESPONDER, 1);
}
static void test_responder2(void)
{
	test_edhoc(RESPONDER, 2);
}
static void test_responder3(void)
{
	test_edhoc(RESPONDER, 3);
}
static void test_responder4(void)
{
	test_edhoc(RESPONDER, 4);
}
static void test_responder8(void)
{
	test_edhoc(RESPONDER, 8);
}
static void test_responder9(void)
{
	test_edhoc(RESPONDER, 9);
}
static void test_responder12(void)
{
	test_edhoc(RESPONDER, 12);
}
static void test_responder13(void)
{
	test_edhoc(RESPONDER, 13);
}
void test_main(void)
{
	ztest_test_suite(initiator_tests, ztest_unit_test(test_initiator1),
			 ztest_unit_test(test_initiator2),
			 ztest_unit_test(test_initiator3),
			 ztest_unit_test(test_initiator4),
			 ztest_unit_test(test_initiator8),
			 ztest_unit_test(test_initiator9),
			 ztest_unit_test(test_initiator12),
			 ztest_unit_test(test_initiator13));

	//ztest_test_suite(initiator_tests, ztest_unit_test(test_initiator1));

	ztest_test_suite(responder_tests, ztest_unit_test(test_responder1),
			 ztest_unit_test(test_responder2),
			 ztest_unit_test(test_responder3),
			 ztest_unit_test(test_responder4),
			 ztest_unit_test(test_responder8),
			 ztest_unit_test(test_responder9),
			 ztest_unit_test(test_responder12),
			 ztest_unit_test(test_responder13));

	//ztest_test_suite(responder_tests, ztest_unit_test(test_responder2));

	ztest_run_test_suite(initiator_tests);
	ztest_run_test_suite(responder_tests);
}
```

## src/edhoc_tests.c
```c
/*
   Copyright (c) 2021 Fraunhofer AISEC. See the COPYRIGHT
   file at the top-level directory of this distribution.

   Licensed under the Apache License, Version 2.0 <LICENSE-APACHE or
   http://www.apache.org/licenses/LICENSE-2.0> or the MIT license
   <LICENSE-MIT or http://opensource.org/licenses/MIT>, at your
   option. This file may not be copied, modified, or distributed
   except according to those terms.
*/

#include <stdio.h>
#include <zephyr.h>
#include <ztest.h>

#include <edhoc.h>
#include "txrx_wrapper.h"
#include "edhoc_tests.h"
#include "../../samples/common/test_vec_parser.h"

struct messages_bufs m_bufs;
struct messages m;

//todo check that as well that the AD are correct
int test_edhoc(enum role p, uint8_t vec_num)
{
	/* oscore declarations*/
	uint8_t oscore_master_secret[16];
	uint8_t oscore_master_salt[8];
	/* edhoc declarations */
	uint8_t PRK_4x3m[PRK_DEFAULT_SIZE];
	uint8_t th4[SHA_DEFAULT_SIZE];
	uint8_t err_msg[ERR_MSG_DEFAULT_SIZE];
	uint32_t err_msg_len = sizeof(err_msg);
	uint8_t ad_1[AD_DEFAULT_SIZE];
	uint64_t ad_1_len = sizeof(ad_1);
	uint8_t ad_2[AD_DEFAULT_SIZE];
	uint64_t ad_2_len = sizeof(ad_2);
	uint8_t ad_3[AD_DEFAULT_SIZE];
	uint64_t ad_3_len = sizeof(ad_3);
	uint8_t ad_4[AD_DEFAULT_SIZE];
	uint64_t ad_4_len = sizeof(ad_2);
	/* test vector inputs */
	char filename[] = { "../../samples/common/edhoc-vectors-json_v11.txt" };
	char test_vec_buf[1024 * 120];
	uint32_t test_vec_buf_len = sizeof(test_vec_buf);
	struct results_bufs res_bufs;
	struct results res;
	int err;
	enum edhoc_error edhoc_error;

	rx_init();

	err = read_test_vectors(filename, test_vec_buf, &test_vec_buf_len);
	zassert_true(err == 0, "reading the testvectors failed");

	err = get_RESULTS_from_test_vec(&res_bufs, &res, vec_num, test_vec_buf,
					test_vec_buf_len);
	zassert_true(err == 0, "parsing results form testvectors failed");

	err = get_MESSAGES_from_test_vec(&m_bufs, &m, vec_num, test_vec_buf,
					 test_vec_buf_len);
	zassert_true(err == 0, "parsing messages form testvectors failed");

	if (p == INITIATOR) {
		uint16_t cred_num = 1;
		struct other_party_cred cred_r;
		struct edhoc_initiator_context c_i;
		struct other_party_cred_bufs other_party_bufs;
		struct edhoc_initiator_context_bufs initiator_context_bufs;

		rx_initiator_switch = true;
		err = get_OTHER_PARTY_CRED_from_test_vec(
			RESPONDER, &other_party_bufs, &cred_r, vec_num,
			test_vec_buf, test_vec_buf_len);
		zassert_true(
			err == 0,
			"parsing other party credentials form testvectors failed");

		err = get_EDHOC_INITIATOR_CONTEXT_from_test_vec(
			&initiator_context_bufs, &c_i, vec_num, test_vec_buf,
			test_vec_buf_len);
		zassert_true(
			err == 0,
			"parsing initiator context form testvectors failed");

		edhoc_error = edhoc_initiator_run(&c_i, &cred_r, cred_num,
						  err_msg, &err_msg_len, ad_2,
						  &ad_2_len, ad_4, &ad_4_len,
						  PRK_4x3m, sizeof(PRK_4x3m),
						  th4, sizeof(th4), tx, rx);
		zassert_true(edhoc_error == 0, "edhoc_initiator_run failed");

	} else {
		const uint16_t num_cred_i_elements = 1;
		struct other_party_cred cred_i;
		struct edhoc_responder_context c_r;
		struct other_party_cred_bufs other_party_bufs;
		struct edhoc_responder_context_bufs responder_context_bufs;

		rx_initiator_switch = false;
		err = get_OTHER_PARTY_CRED_from_test_vec(
			       INITIATOR, &other_party_bufs, &cred_i, vec_num,
			       test_vec_buf, test_vec_buf_len);
		zassert_true(
			err == 0,
			"parsing other party credentials form testvectors failed");

		err = get_EDHOC_RESPONDER_CONTEXT_from_test_vec(
			&responder_context_bufs, &c_r, vec_num, test_vec_buf,
			test_vec_buf_len);
		zassert_true(
			err == 0,
			"parsing responder context form testvectors failed");

		edhoc_error = edhoc_responder_run(
			&c_r, &cred_i, num_cred_i_elements, err_msg,
			&err_msg_len, (uint8_t *)&ad_1, &ad_1_len,
			(uint8_t *)&ad_3, &ad_3_len, PRK_4x3m, sizeof(PRK_4x3m),
			th4, sizeof(th4), tx, rx);
		zassert_true(edhoc_error == 0, "edhoc_responder_run failed");
	}

	edhoc_error = edhoc_exporter(SHA_256, PRK_4x3m, sizeof(PRK_4x3m), th4,
			   sizeof(th4), "OSCORE_Master_Secret",
			   oscore_master_secret, 16);

	zassert_true(edhoc_error == 0, "edhoc_exporter failed");

	edhoc_error = edhoc_exporter(SHA_256, PRK_4x3m, sizeof(PRK_4x3m), th4,
			   sizeof(th4), "OSCORE_Master_Salt",
			   oscore_master_salt, 8);

	zassert_true(edhoc_error == 0, "edhoc_exporter failed");

	/* check th4, PRK_4x3m, OSCORE Master secret and salt are correct */
	zassert_mem_equal__(&PRK_4x3m, res.prk_4x3m.ptr, sizeof(PRK_4x3m),
			    "wrong PRK_4x3m");
	zassert_mem_equal__(&th4, res.th4.ptr, sizeof(th4), "wrong TH4");
	zassert_mem_equal__(&oscore_master_secret, res.oscore_master_secret.ptr,
			    sizeof(oscore_master_secret),
			    "wrong OSCORE Master Secret");
	zassert_mem_equal__(&oscore_master_salt, res.oscore_master_salt.ptr,
			    sizeof(oscore_master_salt),
			    "wrong OSCORE Master Salt");
	return 0;
}
```

## src/main.h
```c
/* SPDX-License-Identifier: Apache-2.0 or MIT at your option */
#define EDHOC_TESTS
```

## src/test_vectors_edhoc.h
```c
/*
   Copyright (c) 2021 Fraunhofer AISEC. See the COPYRIGHT
   file at the top-level directory of this distribution.

   Licensed under the Apache License, Version 2.0 <LICENSE-APACHE or
   http://www.apache.org/licenses/LICENSE-2.0> or the MIT license
   <LICENSE-MIT or http://opensource.org/licenses/MIT>, at your
   option. This file may not be copied, modified, or distributed
   except according to those terms.
*/

#ifndef TEST_VECTORS_EDHOC
#define TEST_VECTORS_EDHOC

#include <stdint.h>

/*
 * Test 1
 * |mode                          | RPK/Cert | suite | Ref [1]
 * |INITIATOR_SK_RESPONDER_SK     | RPK x5t  | 0     | 1-290
 *
 * [1]:https://github.com/lake-wg/edhoc/blob/master/test-vectors/vectors.txt
 */

/******************************************************************************/
/*                              Outputs                                       */
/******************************************************************************/

extern uint8_t T1_PRK_4X3M[];
extern uint32_t T1_PRK_4X3M_LEN;

extern uint8_t T1_TH4[];
extern uint32_t T1_TH4_LEN;

extern uint8_t T1_OSCORE_MSECRET[];
extern uint32_t T1_OSCORE_MSECRET_LEN;

extern uint8_t T1_OSCORE_MSALT[];
extern uint32_t T1_OSCORE_MSALT_LEN;

/******************************************************************************/
/*                              Messages                                      */
/******************************************************************************/

extern uint8_t T1_MSG_1[];
extern uint32_t T1_MSG_1_LEN;

extern uint8_t T1_MSG_2[];
extern uint32_t T1_MSG_2_LEN;

extern uint8_t T1_MSG_3[];
extern uint32_t T1_MSG_3_LEN;

/******************************************************************************/
/*                              Initiator specific                            */
/******************************************************************************/

extern enum method_type T1I__METHOD_TYPE;
extern uint8_t T1I__CORR;

extern uint8_t T1I__SUITES_I[];
extern uint32_t T1I__SUITES_I_LEN;

extern uint8_t T1I__G_X[];
extern uint32_t T1I__G_X_LEN;

extern uint8_t T1I__X[];
extern uint32_t T1I__X_LEN;

extern uint8_t T1I__C_I[];
extern uint32_t T1I__C_I_LEN;

extern uint8_t T1I__AD_1[];
extern uint32_t T1I__AD_1_LEN;

extern uint8_t T1I__AD_3[];
extern uint32_t T1I__AD_3_LEN;

extern uint8_t T1I__I[];
extern uint32_t T1I__I_LEN;

extern uint8_t T1I__G_I[];
extern uint32_t T1I__G_I_LEN;

extern uint8_t T1I__ID_CRED_I[];
extern uint32_t T1I__ID_CRED_I_LEN;

extern uint8_t T1I__CRED_I[];
extern uint32_t T1I__CRED_I_LEN;

extern uint8_t T1I__SK_I[];
extern uint32_t T1I__SK_I_LEN;

extern uint8_t T1I__PK_I[];
extern uint32_t T1I__PK_I_LEN;

/*other party credentials*/
extern uint8_t T1I__ID_CRED_R[];
extern uint32_t T1I__ID_CRED_R_LEN;

extern uint8_t T1I__CRED_R[];
extern uint32_t T1I__CRED_R_LEN;

extern uint8_t T1I__PK_R[];
extern uint32_t T1I__PK_R_LEN;

extern uint8_t T1I__G_R[];
extern uint32_t T1I__G_R_LEN;

extern uint8_t T1I__CA[];
extern uint32_t T1I__CA_LEN;

extern uint8_t T1I__CA_PK[];
extern uint32_t T1I__CA_PK_LEN;

/******************************************************************************/
/*                              Responder specific                            */
/******************************************************************************/

extern uint8_t T1R__SUITES_R[];
extern uint32_t T1R__SUITES_R_LEN;

extern uint8_t T1R__G_Y[];
extern uint32_t T1R__G_Y_LEN;

extern uint8_t T1R__Y[];
extern uint32_t T1R__Y_LEN;

extern uint8_t T1R__C_R[];
extern uint32_t T1R__C_R_LEN;

extern uint8_t T1R__AD_2[];
extern uint32_t T1R__AD_2_LEN;

extern uint8_t T1R__ID_CRED_R[];
extern uint32_t T1R__ID_CRED_R_LEN;

extern uint8_t T1R__CRED_R[];
extern uint32_t T1R__CRED_R_LEN;

extern uint8_t T1R__SK_R[];
extern uint32_t T1R__SK_R_LEN;

extern uint8_t T1R__PK_R[];
extern uint32_t T1R__PK_R_LEN;

extern uint8_t T1R__R[];
extern uint32_t T1R__R_LEN;

extern uint8_t T1R__G_R[];
extern uint32_t T1R__G_R_LEN;

/*other party credentials*/
extern uint8_t T1R__ID_CRED_I[];
extern uint32_t T1R__ID_CRED_I_LEN;

extern uint8_t T1R__CRED_I[];
extern uint32_t T1R__CRED_I_LEN;

extern uint8_t T1R__PK_I[];
extern uint32_t T1R__PK_I_LEN;

extern uint8_t T1R__G_I[];
extern uint32_t T1R__G_I_LEN;

extern uint8_t T1R__CA[];
extern uint32_t T1R__CA_LEN;

extern uint8_t T1R__CA_PK[];
extern uint32_t T1R__CA_PK_LEN;

/*
 * Test 2
 * |mode                          | RPK/Cert | suite    | Ref [1]
 * |INITIATOR_SDHK_RESPONDER_SDHK | RPK kid  | 0        | 292-540
 *
 * [1]:https://github.com/lake-wg/edhoc/blob/master/test-vectors/vectors.txt
 */
/******************************************************************************/
/*                              Outputs                                       */
/******************************************************************************/

extern uint8_t T2_PRK_4X3M[];
extern uint32_t T2_PRK_4X3M_LEN;

extern uint8_t T2_TH4[];
extern uint32_t T2_TH4_LEN;

extern uint8_t T2_OSCORE_MSECRET[];
extern uint32_t T2_OSCORE_MSECRET_LEN;

extern uint8_t T2_OSCORE_MSALT[];
extern uint32_t T2_OSCORE_MSALT_LEN;

/******************************************************************************/
/*                              Messages                                      */
/******************************************************************************/

extern uint8_t T2_MSG_1[];
extern uint32_t T2_MSG_1_LEN;

extern uint8_t T2_MSG_2[];
extern uint32_t T2_MSG_2_LEN;

extern uint8_t T2_MSG_3[];
extern uint32_t T2_MSG_3_LEN;

/******************************************************************************/
/*                              Initiator specific                            */
/******************************************************************************/

extern enum method_type T2I__METHOD_TYPE;
extern uint8_t T2I__CORR;

extern uint8_t T2I__SUITES_I[];
extern uint32_t T2I__SUITES_I_LEN;

extern uint8_t T2I__G_X[];
extern uint32_t T2I__G_X_LEN;

extern uint8_t T2I__X[];
extern uint32_t T2I__X_LEN;

extern uint8_t T2I__C_I[];
extern uint32_t T2I__C_I_LEN;

extern uint8_t T2I__AD_1[];
extern uint32_t T2I__AD_1_LEN;

extern uint8_t T2I__AD_3[];
extern uint32_t T2I__AD_3_LEN;

extern uint8_t T2I__I[];
extern uint32_t T2I__I_LEN;

extern uint8_t T2I__G_I[];
extern uint32_t T2I__G_I_LEN;

extern uint8_t T2I__ID_CRED_I[];
extern uint32_t T2I__ID_CRED_I_LEN;

extern uint8_t T2I__CRED_I[];
extern uint32_t T2I__CRED_I_LEN;

extern uint8_t T2I__SK_I[];
extern uint32_t T2I__SK_I_LEN;

extern uint8_t T2I__PK_I[];
extern uint32_t T2I__PK_I_LEN;

/*other party credentials*/
extern uint8_t T2I__ID_CRED_R[];
extern uint32_t T2I__ID_CRED_R_LEN;

extern uint8_t T2I__CRED_R[];
extern uint32_t T2I__CRED_R_LEN;

extern uint8_t T2I__PK_R[];
extern uint32_t T2I__PK_R_LEN;

extern uint8_t T2I__G_R[];
extern uint32_t T2I__G_R_LEN;

extern uint8_t T2I__CA[];
extern uint32_t T2I__CA_LEN;

extern uint8_t T2I__CA_PK[];
extern uint32_t T2I__CA_PK_LEN;

/******************************************************************************/
/*                              Responder specific                            */
/******************************************************************************/

extern uint8_t T2R__SUITES_R[];
extern uint32_t T2R__SUITES_R_LEN;

extern uint8_t T2R__G_Y[];
extern uint32_t T2R__G_Y_LEN;

extern uint8_t T2R__Y[];
extern uint32_t T2R__Y_LEN;

extern uint8_t T2R__C_R[];
extern uint32_t T2R__C_R_LEN;

extern uint8_t T2R__AD_2[];
extern uint32_t T2R__AD_2_LEN;

extern uint8_t T2R__ID_CRED_R[];
extern uint32_t T2R__ID_CRED_R_LEN;

extern uint8_t T2R__CRED_R[];
extern uint32_t T2R__CRED_R_LEN;

extern uint8_t T2R__SK_R[];
extern uint32_t T2R__SK_R_LEN;

extern uint8_t T2R__PK_R[];
extern uint32_t T2R__PK_R_LEN;

extern uint8_t T2R__R[];
extern uint32_t T2R__R_LEN;

extern uint8_t T2R__G_R[];
extern uint32_t T2R__G_R_LEN;

/*other party credentials*/
extern uint8_t T2R__ID_CRED_I[];
extern uint32_t T2R__ID_CRED_I_LEN;

extern uint8_t T2R__CRED_I[];
extern uint32_t T2R__CRED_I_LEN;

extern uint8_t T2R__PK_I[];
extern uint32_t T2R__PK_I_LEN;

extern uint8_t T2R__G_I[];
extern uint32_t T2R__G_I_LEN;

extern uint8_t T2R__CA[];
extern uint32_t T2R__CA_LEN;

extern uint8_t T2R__CA_PK[];
extern uint32_t T2R__CA_PK_LEN;

/*
 * Test 3
 * |mode                          | RPK/Cert | suite    | Ref [1]
 * |INITIATOR_SK_RESPONDER_SK     | x5chain  | 0        | none
 *
 * [1]:https://github.com/lake-wg/edhoc/blob/master/test-vectors/vectors.txt
 */
/******************************************************************************/
/*                              Outputs                                       */
/******************************************************************************/

extern uint8_t T3_PRK_4X3M[];
extern uint32_t T3_PRK_4X3M_LEN;

extern uint8_t T3_TH4[];
extern uint32_t T3_TH4_LEN;

extern uint8_t T3_OSCORE_MSECRET[];
extern uint32_t T3_OSCORE_MSECRET_LEN;

extern uint8_t T3_OSCORE_MSALT[];
extern uint32_t T3_OSCORE_MSALT_LEN;

/******************************************************************************/
/*                              Messages                                      */
/******************************************************************************/

extern uint8_t T3_MSG_1[];
extern uint32_t T3_MSG_1_LEN;

extern uint8_t T3_MSG_2[];
extern uint32_t T3_MSG_2_LEN;

extern uint8_t T3_MSG_3[];
extern uint32_t T3_MSG_3_LEN;

/******************************************************************************/
/*                              Initiator specific                            */
/******************************************************************************/

extern enum method_type T3I__METHOD_TYPE;
extern uint8_t T3I__CORR;

extern uint8_t T3I__SUITES_I[];
extern uint32_t T3I__SUITES_I_LEN;

extern uint8_t T3I__G_X[];
extern uint32_t T3I__G_X_LEN;

extern uint8_t T3I__X[];
extern uint32_t T3I__X_LEN;

extern uint8_t T3I__C_I[];
extern uint32_t T3I__C_I_LEN;

extern uint8_t T3I__AD_1[];
extern uint32_t T3I__AD_1_LEN;

extern uint8_t T3I__AD_3[];
extern uint32_t T3I__AD_3_LEN;

extern uint8_t T3I__I[];
extern uint32_t T3I__I_LEN;

extern uint8_t T3I__G_I[];
extern uint32_t T3I__G_I_LEN;

extern uint8_t T3I__ID_CRED_I[];
extern uint32_t T3I__ID_CRED_I_LEN;

extern uint8_t T3I__CRED_I[];
extern uint32_t T3I__CRED_I_LEN;

extern uint8_t T3I__SK_I[];
extern uint32_t T3I__SK_I_LEN;

extern uint8_t T3I__PK_I[];
extern uint32_t T3I__PK_I_LEN;

/*other party credentials*/
extern uint8_t T3I__ID_CRED_R[];
extern uint32_t T3I__ID_CRED_R_LEN;

extern uint8_t T3I__CRED_R[];
extern uint32_t T3I__CRED_R_LEN;

extern uint8_t T3I__PK_R[];
extern uint32_t T3I__PK_R_LEN;

extern uint8_t T3I__G_R[];
extern uint32_t T3I__G_R_LEN;

extern uint8_t T3I__CA[];
extern uint32_t T3I__CA_LEN;

extern uint8_t T3I__CA_PK[];
extern uint32_t T3I__CA_PK_LEN;

/******************************************************************************/
/*                              Responder specific                            */
/******************************************************************************/

extern uint8_t T3R__SUITES_R[];
extern uint32_t T3R__SUITES_R_LEN;

extern uint8_t T3R__G_Y[];
extern uint32_t T3R__G_Y_LEN;

extern uint8_t T3R__Y[];
extern uint32_t T3R__Y_LEN;

extern uint8_t T3R__C_R[];
extern uint32_t T3R__C_R_LEN;

extern uint8_t T3R__AD_2[];
extern uint32_t T3R__AD_2_LEN;

extern uint8_t T3R__ID_CRED_R[];
extern uint32_t T3R__ID_CRED_R_LEN;

extern uint8_t T3R__CRED_R[];
extern uint32_t T3R__CRED_R_LEN;

extern uint8_t T3R__SK_R[];
extern uint32_t T3R__SK_R_LEN;

extern uint8_t T3R__PK_R[];
extern uint32_t T3R__PK_R_LEN;

extern uint8_t T3R__R[];
extern uint32_t T3R__R_LEN;

extern uint8_t T3R__G_R[];
extern uint32_t T3R__G_R_LEN;

/*other party credentials*/
extern uint8_t T3R__ID_CRED_I[];
extern uint32_t T3R__ID_CRED_I_LEN;

extern uint8_t T3R__CRED_I[];
extern uint32_t T3R__CRED_I_LEN;

extern uint8_t T3R__PK_I[];
extern uint32_t T3R__PK_I_LEN;

extern uint8_t T3R__G_I[];
extern uint32_t T3R__G_I_LEN;

extern uint8_t T3R__CA[];
extern uint32_t T3R__CA_LEN;

extern uint8_t T3R__CA_PK[];
extern uint32_t T3R__CA_PK_LEN;

/*
 * Test 4
 * |mode                          | RPK/Cert | suite    | Ref [1]
 * |INITIATOR_SDHK_RESPONDER_SDHK | x5chain  | 0        | none
 *
 * [1]:https://github.com/lake-wg/edhoc/blob/master/test-vectors/vectors.txt
 */
/******************************************************************************/
/*                              Outputs                                       */
/******************************************************************************/

extern uint8_t T4_PRK_4X3M[];
extern uint32_t T4_PRK_4X3M_LEN;

extern uint8_t T4_TH4[];
extern uint32_t T4_TH4_LEN;

extern uint8_t T4_OSCORE_MSECRET[];
extern uint32_t T4_OSCORE_MSECRET_LEN;

extern uint8_t T4_OSCORE_MSALT[];
extern uint32_t T4_OSCORE_MSALT_LEN;

/******************************************************************************/
/*                              Messages                                      */
/******************************************************************************/

extern uint8_t T4_MSG_1[];
extern uint32_t T4_MSG_1_LEN;

extern uint8_t T4_MSG_2[];
extern uint32_t T4_MSG_2_LEN;

extern uint8_t T4_MSG_3[];
extern uint32_t T4_MSG_3_LEN;

/******************************************************************************/
/*                              Initiator specific                            */
/******************************************************************************/

extern enum method_type T4I__METHOD_TYPE;
extern uint8_t T4I__CORR;

extern uint8_t T4I__SUITES_I[];
extern uint32_t T4I__SUITES_I_LEN;

extern uint8_t T4I__G_X[];
extern uint32_t T4I__G_X_LEN;

extern uint8_t T4I__X[];
extern uint32_t T4I__X_LEN;

extern uint8_t T4I__C_I[];
extern uint32_t T4I__C_I_LEN;

extern uint8_t T4I__AD_1[];
extern uint32_t T4I__AD_1_LEN;

extern uint8_t T4I__AD_3[];
extern uint32_t T4I__AD_3_LEN;

extern uint8_t T4I__I[];
extern uint32_t T4I__I_LEN;

extern uint8_t T4I__G_I[];
extern uint32_t T4I__G_I_LEN;

extern uint8_t T4I__ID_CRED_I[];
extern uint32_t T4I__ID_CRED_I_LEN;

extern uint8_t T4I__CRED_I[];
extern uint32_t T4I__CRED_I_LEN;

extern uint8_t T4I__SK_I[];
extern uint32_t T4I__SK_I_LEN;

extern uint8_t T4I__PK_I[];
extern uint32_t T4I__PK_I_LEN;

/*other party credentials*/
extern uint8_t T4I__ID_CRED_R[];
extern uint32_t T4I__ID_CRED_R_LEN;

extern uint8_t T4I__CRED_R[];
extern uint32_t T4I__CRED_R_LEN;

extern uint8_t T4I__PK_R[];
extern uint32_t T4I__PK_R_LEN;

extern uint8_t T4I__G_R[];
extern uint32_t T4I__G_R_LEN;

extern uint8_t T4I__CA[];
extern uint32_t T4I__CA_LEN;

extern uint8_t T4I__CA_PK[];
extern uint32_t T4I__CA_PK_LEN;

/******************************************************************************/
/*                              Responder specific                            */
/******************************************************************************/

extern uint8_t T4R__SUITES_R[];
extern uint32_t T4R__SUITES_R_LEN;

extern uint8_t T4R__G_Y[];
extern uint32_t T4R__G_Y_LEN;

extern uint8_t T4R__Y[];
extern uint32_t T4R__Y_LEN;

extern uint8_t T4R__C_R[];
extern uint32_t T4R__C_R_LEN;

extern uint8_t T4R__AD_2[];
extern uint32_t T4R__AD_2_LEN;

extern uint8_t T4R__ID_CRED_R[];
extern uint32_t T4R__ID_CRED_R_LEN;

extern uint8_t T4R__CRED_R[];
extern uint32_t T4R__CRED_R_LEN;

extern uint8_t T4R__SK_R[];
extern uint32_t T4R__SK_R_LEN;

extern uint8_t T4R__PK_R[];
extern uint32_t T4R__PK_R_LEN;

extern uint8_t T4R__R[];
extern uint32_t T4R__R_LEN;

extern uint8_t T4R__G_R[];
extern uint32_t T4R__G_R_LEN;

/*other party credentials*/
extern uint8_t T4R__ID_CRED_I[];
extern uint32_t T4R__ID_CRED_I_LEN;

extern uint8_t T4R__CRED_I[];
extern uint32_t T4R__CRED_I_LEN;

extern uint8_t T4R__PK_I[];
extern uint32_t T4R__PK_I_LEN;

extern uint8_t T4R__G_I[];
extern uint32_t T4R__G_I_LEN;

extern uint8_t T4R__CA[];
extern uint32_t T4R__CA_LEN;

extern uint8_t T4R__CA_PK[];
extern uint32_t T4R__CA_PK_LEN;
#endif /*TEST_VECTORS_EDHOC*/
```

## src/test_vectors_oscore.c
```c
/*
   Copyright (c) 2021 Fraunhofer AISEC. See the COPYRIGHT
   file at the top-level directory of this distribution.

   Licensed under the Apache License, Version 2.0 <LICENSE-APACHE or
   http://www.apache.org/licenses/LICENSE-2.0> or the MIT license
   <LICENSE-MIT or http://opensource.org/licenses/MIT>, at your
   option. This file may not be copied, modified, or distributed
   except according to those terms.
*/
#include "oscore.h"

/**
 * Test 1:
 * - Client Key derivation with master salt see RFC8613 Appendix C.1.1
 * - Generating OSCORE request with key form C.1.1 see RFC8613 Appendix C.4 
 */

/*Test vector C1.1: Key derivation with Master Salt*/
uint8_t T1__MASTER_SECRET[16] = { 0x01, 0x02, 0x03, 0x04, 0x05, 0x06,
				  0x07, 0x08, 0x09, 0x0a, 0x0b, 0x0c,
				  0x0d, 0x0e, 0x0f, 0x10 };
uint8_t T1__MASTER_SECRET_LEN = sizeof(T1__MASTER_SECRET);

uint8_t *T1__SENDER_ID = NULL;
uint8_t T1__SENDER_ID_LEN = 0;

uint8_t T1__RECIPIENT_ID[1] = { 0x01 };
uint8_t T1__RECIPIENT_ID_LEN = sizeof(T1__RECIPIENT_ID);

uint8_t T1__MASTER_SALT[8] = { 0x9e, 0x7c, 0xa9, 0x22, 0x23, 0x78, 0x63, 0x40 };
uint8_t T1__MASTER_SALT_LEN = sizeof(T1__MASTER_SALT);

uint8_t *T1__ID_CONTEXT = NULL;
uint8_t T1__ID_CONTEXT_LEN = 0;

/*Test vector C4: Generating a OSCORE Packet with key material form test vector C.1 */
uint8_t T1__COAP_REQ[] = { 0x44, 0x01, 0x5d, 0x1f, 0x00, 0x00, 0x39, 0x74,
			   0x39, 0x6c, 0x6f, 0x63, 0x61, 0x6c, 0x68, 0x6f,
			   0x73, 0x74, 0x83, 0x74, 0x76, 0x31 };
uint16_t T1__COAP_REQ_LEN = sizeof(T1__COAP_REQ);

/*Expected result*/
uint8_t T1__SENDER_KEY[] = { 0xf0, 0x91, 0x0e, 0xd7, 0x29, 0x5e, 0x6a, 0xd4,
			     0xb5, 0x4f, 0xc7, 0x93, 0x15, 0x43, 0x02, 0xff };
uint8_t T1__SENDER_KEY_LEN = sizeof(T1__SENDER_KEY);

uint8_t T1__RECIPIENT_KEY[] = { 0xff, 0xb1, 0x4e, 0x09, 0x3c, 0x94, 0xc9, 0xca,
				0xc9, 0x47, 0x16, 0x48, 0xb4, 0xf9, 0x87, 0x10 };
uint8_t T1__RECIPIENT_KEY_LEN = sizeof(T1__RECIPIENT_KEY);

uint8_t T1__COMMON_IV[] = { 0x46, 0x22, 0xd4, 0xdd, 0x6d, 0x94, 0x41,
			    0x68, 0xee, 0xfb, 0x54, 0x98, 0x7c };
uint8_t T1__COMMON_IV_LEN = sizeof(T1__COMMON_IV);

uint8_t T1__OSCORE_REQ[] = { 0x44, 0x02, 0x5d, 0x1f, 0x00, 0x00, 0x39,
			     0x74, 0x39, 0x6c, 0x6f, 0x63, 0x61, 0x6c,
			     0x68, 0x6f, 0x73, 0x74, 0x62, 0x09, 0x14,
			     0xff, 0x61, 0x2f, 0x10, 0x92, 0xf1, 0x77,
			     0x6f, 0x1c, 0x16, 0x68, 0xb3, 0x82, 0x5e };
uint8_t T1__OSCORE_REQ_LEN = sizeof(T1__OSCORE_REQ);

/**
 * Test 2:
 * - Server Key derivation with master salt see RFC8613 Appendix C.1.2
 * - Generating OSCORE response with key form C.1.2 see RFC8613 Appendix C.7 
 */
uint8_t T2__MASTER_SECRET[16] = { 0x01, 0x02, 0x03, 0x04, 0x05, 0x06,
				  0x07, 0x08, 0x09, 0x0a, 0x0b, 0x0c,
				  0x0d, 0x0e, 0x0f, 0x10 };
uint8_t T2__MASTER_SECRET_LEN = sizeof(T2__MASTER_SECRET);

uint8_t T2__SENDER_ID[] = { 0x01 };
uint8_t T2__SENDER_ID_LEN = sizeof(T2__SENDER_ID);

uint8_t *T2__RECIPIENT_ID = NULL;
uint8_t T2__RECIPIENT_ID_LEN = 0;

uint8_t T2__MASTER_SALT[8] = { 0x9e, 0x7c, 0xa9, 0x22, 0x23, 0x78, 0x63, 0x40 };
uint8_t T2__MASTER_SALT_LEN = sizeof(T2__MASTER_SALT);

uint8_t *T2__ID_CONTEXT = NULL;
uint8_t T2__ID_CONTEXT_LEN = 0;

/*The OSCORE message created in C4 (35 Byte). Constructed from a CoAP request of length 22. This request contains no payload. The request contains only Uri-host (locahost) and Uri-path option (tv1). In the OSCORE packet Uri-host option is transferred as plain normal option, The Uri-path is contained in the ciphertext. */
uint8_t T2__OSCORE_REQ[] = { 0x44, 0x02, 0x5d, 0x1f, 0x00, 0x00, 0x39,
			     0x74, 0x39, 0x6c, 0x6f, 0x63, 0x61, 0x6c,
			     0x68, 0x6f, 0x73, 0x74, 0x62, 0x09, 0x14,
			     0xff, 0x61, 0x2f, 0x10, 0x92, 0xf1, 0x77,
			     0x6f, 0x1c, 0x16, 0x68, 0xb3, 0x82, 0x5e };
uint8_t T2__OSCORE_REQ_LEN = sizeof(T2__OSCORE_REQ);

/*Unprotected CoAP response (21 bytes)*/
/*Contains the payload "Hello World!"*/
uint8_t T2__COAP_RESPONSE[] = { 0x64, 0x45, 0x5d, 0x1f, 0x00, 0x00, 0x39,
				0x74, 0xff, 0x48, 0x65, 0x6c, 0x6c, 0x6f,
				0x20, 0x57, 0x6f, 0x72, 0x6c, 0x64, 0x21 };
uint8_t T2__COAP_RESPONSE_LEN = sizeof(T2__COAP_RESPONSE);

/*Expected result*/
/*the  reconstructed coap request see Appendix C4*/
uint8_t T2__COAP_REQ[] = { 0x44, 0x01, 0x5d, 0x1f, 0x00, 0x00, 0x39, 0x74,
			   0x39, 0x6c, 0x6f, 0x63, 0x61, 0x6c, 0x68, 0x6f,
			   0x73, 0x74, 0x83, 0x74, 0x76, 0x31 };
uint8_t T2__COAP_REQ_LEN = sizeof(T2__COAP_REQ);

uint8_t T2__OSCORE_RESP[] = { 0x64, 0x44, 0x5D, 0x1F, 0x00, 0x00, 0x39, 0x74,
			      0x90, 0xFF, 0xDB, 0xAA, 0xD1, 0xE9, 0xA7, 0xE7,
			      0xB2, 0xA8, 0x13, 0xD3, 0xC3, 0x15, 0x24, 0x37,
			      0x83, 0x03, 0xCD, 0xAF, 0xAE, 0x11, 0x91, 0x06 };
uint8_t T2__OSCORE_RESP_LEN = sizeof(T2__OSCORE_RESP);

/**
 * Test 3:
 * - Client Key derivation without master salt see RFC8613 Appendix C.2.1
 * - Generating OSCORE request with key form C.2.1 see RFC8613 Appendix C.5 
 */
/*Test vector C2.1: Key derivation without Master Salt*/
uint8_t T3__MASTER_SECRET[16] = { 0x01, 0x02, 0x03, 0x04, 0x05, 0x06,
				  0x07, 0x08, 0x09, 0x0a, 0x0b, 0x0c,
				  0x0d, 0x0e, 0x0f, 0x10 };
uint8_t T3__MASTER_SECRET_LEN = sizeof(T3__MASTER_SECRET);

uint8_t T3__SENDER_ID[1] = { 0x00 };
uint8_t T3__SENDER_ID_LEN = sizeof(T3__SENDER_ID);

uint8_t T3__RECIPIENT_ID[1] = { 0x01 };
uint8_t T3__RECIPIENT_ID_LEN = sizeof(T3__RECIPIENT_ID);

uint8_t *T3__MASTER_SALT = NULL;
uint8_t T3__MASTER_SALT_LEN = 0;

uint8_t *T3__ID_CONTEXT = NULL;
uint8_t T3__ID_CONTEXT_LEN = 0;

/*Test vector C5: Generating a OSCORE Packet with key material form test vector C.2.1 */
uint8_t T3__COAP_REQ[] = { 0x44, 0x01, 0x71, 0xc3, 0x00, 0x00, 0xb9, 0x32,
			   0x39, 0x6c, 0x6f, 0x63, 0x61, 0x6c, 0x68, 0x6f,
			   0x73, 0x74, 0x83, 0x74, 0x76, 0x31 };
uint16_t T3__COAP_REQ_LEN = sizeof(T3__COAP_REQ);

/*expected result*/
uint8_t T3__OSCORE_REQ[] = { 0x44, 0x02, 0x71, 0xc3, 0x00, 0x00, 0xb9, 0x32,
			     0x39, 0x6c, 0x6f, 0x63, 0x61, 0x6c, 0x68, 0x6f,
			     0x73, 0x74, 0x63, 0x09, 0x14, 0x00, 0xff, 0x4e,
			     0xd3, 0x39, 0xa5, 0xa3, 0x79, 0xb0, 0xb8, 0xbc,
			     0x73, 0x1f, 0xff, 0xb0 };
uint8_t T3__OSCORE_REQ_LEN = sizeof(T3__OSCORE_REQ);

/**
 * Test 4:
 * - Server Key derivation without master salt see RFC8613 Appendix C.2.2
 */
/*Test vector C2.2: Key derivation without Master Salt*/
uint8_t T4__MASTER_SECRET[16] = { 0x01, 0x02, 0x03, 0x04, 0x05, 0x06,
				  0x07, 0x08, 0x09, 0x0a, 0x0b, 0x0c,
				  0x0d, 0x0e, 0x0f, 0x10 };
uint8_t T4__MASTER_SECRET_LEN = sizeof(T4__MASTER_SECRET);

uint8_t T4__SENDER_ID[1] = { 0x01 };
uint8_t T4__SENDER_ID_LEN = sizeof(T4__SENDER_ID);

uint8_t T4__RECIPIENT_ID[1] = { 0x00 };
uint8_t T4__RECIPIENT_ID_LEN = sizeof(T4__RECIPIENT_ID);

uint8_t *T4__MASTER_SALT = NULL;
uint8_t T4__MASTER_SALT_LEN = 0;

uint8_t *T4__ID_CONTEXT = NULL;
uint8_t T4__ID_CONTEXT_LEN = 0;

/*expected result*/
uint8_t T4__SENDER_KEY[] = { 0xe5, 0x7b, 0x56, 0x35, 0x81, 0x51, 0x77, 0xcd,
			     0x67, 0x9a, 0xb4, 0xbc, 0xec, 0x9d, 0x7d, 0xda };
uint8_t T4__SENDER_KEY_LEN = sizeof(T4__SENDER_KEY);

uint8_t T4__RECIPIENT_KEY[] = { 0x32, 0x1b, 0x26, 0x94, 0x32, 0x53, 0xc7, 0xff,
				0xb6, 0x00, 0x3b, 0x0b, 0x64, 0xd7, 0x40, 0x41 };
uint8_t T4__RECIPIENT_KEY_LEN = sizeof(T4__RECIPIENT_KEY);

uint8_t T4__COMMON_IV[] = { 0xbe, 0x35, 0xae, 0x29, 0x7d, 0x2d, 0xac,
			    0xe9, 0x10, 0xc5, 0x2e, 0x99, 0xf9 };
uint8_t T4__COMMON_IV_LEN = sizeof(T4__COMMON_IV);

/**
 * Test 5 :
 * - Client Key derivation with ID Context see Appendix 3.1
 * - OSCORE request generation see Appendix C6
 */
/*Test vector C3.1: Key derivation with ID Context*/
uint8_t T5__MASTER_SECRET[16] = { 0x01, 0x02, 0x03, 0x04, 0x05, 0x06,
				  0x07, 0x08, 0x09, 0x0a, 0x0b, 0x0c,
				  0x0d, 0x0e, 0x0f, 0x10 };
uint8_t T5__MASTER_SECRET_LEN = sizeof(T5__MASTER_SECRET);

uint8_t *T5__SENDER_ID = NULL;
uint8_t T5__SENDER_ID_LEN = 0;

uint8_t T5__RECIPIENT_ID[1] = { 0x01 };
uint8_t T5__RECIPIENT_ID_LEN = sizeof(T5__RECIPIENT_ID);

uint8_t T5__MASTER_SALT[8] = { 0x9e, 0x7c, 0xa9, 0x22, 0x23, 0x78, 0x63, 0x40 };
uint8_t T5__MASTER_SALT_LEN = sizeof(T5__MASTER_SALT);

uint8_t T5__ID_CONTEXT[8] = { 0x37, 0xcb, 0xf3, 0x21, 0x00, 0x17, 0xa2, 0xd3 };
uint8_t T5__ID_CONTEXT_LEN = sizeof(T5__ID_CONTEXT);

/*Test vector C6: Generating a OSCORE Packet with key material form test vector C.2.1 */
uint8_t T5__COAP_REQ[] = { 0x44, 0x01, 0x2f, 0x8e, 0xef, 0x9b, 0xbf, 0x7a,
			   0x39, 0x6c, 0x6f, 0x63, 0x61, 0x6c, 0x68, 0x6f,
			   0x73, 0x74, 0x83, 0x74, 0x76, 0x31 };
uint16_t T5__COAP_REQ_LEN = sizeof(T5__COAP_REQ);

/*Expected result*/
uint8_t T5__OSCORE_REQ[] = { 0x44, 0x02, 0x2f, 0x8e, 0xef, 0x9b, 0xbf, 0x7a,
			     0x39, 0x6c, 0x6f, 0x63, 0x61, 0x6c, 0x68, 0x6f,
			     0x73, 0x74, 0x6b, 0x19, 0x14, 0x08, 0x37, 0xcb,
			     0xf3, 0x21, 0x00, 0x17, 0xa2, 0xd3, 0xff, 0x72,
			     0xcd, 0x72, 0x73, 0xfd, 0x33, 0x1a, 0xc4, 0x5c,
			     0xff, 0xbe, 0x55, 0xc3 };
uint8_t T5__OSCORE_REQ_LEN = sizeof(T5__OSCORE_REQ);

/**
 * Test 6:
 * - Server Key derivation with ID context see RFC8613 Appendix C.3.2
 */
uint8_t T6__MASTER_SECRET[16] = { 0x01, 0x02, 0x03, 0x04, 0x05, 0x06,
				  0x07, 0x08, 0x09, 0x0a, 0x0b, 0x0c,
				  0x0d, 0x0e, 0x0f, 0x10 };
uint8_t T6__MASTER_SECRET_LEN = sizeof(T6__MASTER_SECRET);

uint8_t T6__SENDER_ID[1] = { 0x01 };
uint8_t T6__SENDER_ID_LEN = sizeof(T6__SENDER_ID);

uint8_t *T6__RECIPIENT_ID = NULL;
uint8_t T6__RECIPIENT_ID_LEN = 0;

uint8_t T6__MASTER_SALT[8] = { 0x9e, 0x7c, 0xa9, 0x22, 0x23, 0x78, 0x63, 0x40 };
uint8_t T6__MASTER_SALT_LEN = sizeof(T5__MASTER_SALT);

uint8_t T6__ID_CONTEXT[8] = { 0x37, 0xcb, 0xf3, 0x21, 0x00, 0x17, 0xa2, 0xd3 };
uint8_t T6__ID_CONTEXT_LEN = sizeof(T5__ID_CONTEXT);

/*expected result*/
uint8_t T6__SENDER_KEY[] = { 0xe3, 0x9a, 0x0c, 0x7c, 0x77, 0xb4, 0x3f, 0x03,
			     0xb4, 0xb3, 0x9a, 0xb9, 0xa2, 0x68, 0x69, 0x9f };
uint8_t T6__SENDER_KEY_LEN = sizeof(T6__SENDER_KEY);

uint8_t T6__RECIPIENT_KEY[] = { 0xaf, 0x2a, 0x13, 0x00, 0xa5, 0xe9, 0x57, 0x88,
				0xb3, 0x56, 0x33, 0x6e, 0xee, 0xcd, 0x2b, 0x92 };
uint8_t T6__RECIPIENT_KEY_LEN = sizeof(T6__RECIPIENT_KEY);

uint8_t T6__COMMON_IV[] = { 0x2c, 0xa5, 0x8f, 0xb8, 0x5f, 0xf1, 0xb8,
			    0x1c, 0x0b, 0x71, 0x81, 0xb8, 0x5e };
uint8_t T6__COMMON_IV_LEN = sizeof(T6__COMMON_IV);

/**
 * Test 7:
 * - Server with partial IV see Appendix C8
 * - currently not supported
 */
uint8_t T7__MASTER_SECRET[16] = { 0x01, 0x02, 0x03, 0x04, 0x05, 0x06,
				  0x07, 0x08, 0x09, 0x0a, 0x0b, 0x0c,
				  0x0d, 0x0e, 0x0f, 0x10 };
uint8_t T7__MASTER_SECRET_LEN = sizeof(T7__MASTER_SECRET);

uint8_t T7__SENDER_ID[] = { 0x01 };
uint8_t T7__SENDER_ID_LEN = sizeof(T7__SENDER_ID);

uint8_t *T7__RECIPIENT_ID = NULL;
uint8_t T7__RECIPIENT_ID_LEN = 0;

uint8_t T7__MASTER_SALT[8] = { 0x9e, 0x7c, 0xa9, 0x22, 0x23, 0x78, 0x63, 0x40 };
uint8_t T7__MASTER_SALT_LEN = sizeof(T7__MASTER_SALT);

uint8_t *T7__ID_CONTEXT = NULL;
uint8_t T7__ID_CONTEXT_LEN = 0;

/*Test vector C4: Generating a OSCORE Packet with key material form test vector C.1 */
/*the OSCORE message created in C4*/
uint8_t T7__OSCORE_REQ[] = { 0x44, 0x02, 0x5d, 0x1f, 0x00, 0x00, 0x39,
			     0x74, 0x39, 0x6c, 0x6f, 0x63, 0x61, 0x6c,
			     0x68, 0x6f, 0x73, 0x74, 0x62, 0x09, 0x14,
			     0xff, 0x61, 0x2f, 0x10, 0x92, 0xf1, 0x77,
			     0x6f, 0x1c, 0x16, 0x68, 0xb3, 0x82, 0x5e };
uint8_t T7__OSCORE_REQ_LEN = sizeof(T7__OSCORE_REQ);

/*unprotected CoAP response*/
uint8_t T7__COAP_RESPONSE[] = { 0x64, 0x45, 0x5d, 0x1f, 0x00, 0x00, 0x39,
				0x74, 0xff, 0x48, 0x65, 0x6c, 0x6c, 0x6f,
				0x20, 0x57, 0x6f, 0x72, 0x6c, 0x64, 0x21 };
uint8_t T7__COAP_RESPONSE_LEN = sizeof(T7__COAP_RESPONSE);

/*expected result*/
uint8_t T7__OSCORE_RES[] = { 0x64, 0x44, 0x5d, 0x1f, 0x00, 0x00, 0x39,
			     0x74, 0x92, 0x01, 0x00, 0xff, 0x4d, 0x4c,
			     0x13, 0x66, 0x93, 0x84, 0xb6, 0x73, 0x54,
			     0xb2, 0xb6, 0x17, 0x5f, 0xf4, 0xb8, 0x65,
			     0x8c, 0x66, 0x6a, 0x6c, 0xf8, 0x8e };
uint8_t T7__OSCORE_RES_LEN = sizeof(T7__OSCORE_RES);
```

## src/test_vectors_oscore.h
```c
/*
   Copyright (c) 2021 Fraunhofer AISEC. See the COPYRIGHT
   file at the top-level directory of this distribution.

   Licensed under the Apache License, Version 2.0 <LICENSE-APACHE or
   http://www.apache.org/licenses/LICENSE-2.0> or the MIT license
   <LICENSE-MIT or http://opensource.org/licenses/MIT>, at your
   option. This file may not be copied, modified, or distributed
   except according to those terms.
*/

#ifndef TEST_VECTORS_OSCORE
#define TEST_VECTORS_OSCORE

#include <stdint.h>
/**
 * Test 1:
 * - Key derivation without master salt see RFC8613 Appendix C.1.1
 * - Generating OSCORE request with key form C.1.1  
 */

/*Test vector C1.1: Key derivation with Master Salt*/
extern uint8_t T1__MASTER_SECRET[16];
extern uint8_t T1__MASTER_SECRET_LEN;

extern uint8_t* T1__SENDER_ID;
extern uint8_t T1__SENDER_ID_LEN;

extern uint8_t T1__RECIPIENT_ID[1];
extern uint8_t T1__RECIPIENT_ID_LEN;

extern uint8_t T1__MASTER_SALT[8];
extern uint8_t T1__MASTER_SALT_LEN;

extern uint8_t* T1__ID_CONTEXT;
extern uint8_t T1__ID_CONTEXT_LEN;

/*Test vector C4: Generating a OSCORE Packet with key material form test vector C.1 */
extern uint8_t T1__COAP_REQ[];
extern uint16_t T1__COAP_REQ_LEN;

/*Expected result*/
extern uint8_t T1__SENDER_KEY[];
extern uint8_t T1__SENDER_KEY_LEN;

extern uint8_t T1__RECIPIENT_KEY[];
extern uint8_t T1__RECIPIENT_KEY_LEN;

extern uint8_t T1__COMMON_IV[];
extern uint8_t T1__COMMON_IV_LEN;

extern uint8_t T1__OSCORE_REQ[];
extern uint8_t T1__OSCORE_REQ_LEN;

/**
 * Test 2:
 * - Server Key derivation without master salt see RFC8613 Appendix C.1.2
 * - Generating OSCORE response with key form C.1.2 see RFC8613 Appendix C.7 
 */
extern uint8_t T2__MASTER_SECRET[16];
extern uint8_t T2__MASTER_SECRET_LEN;

extern uint8_t T2__SENDER_ID[];
extern uint8_t T2__SENDER_ID_LEN;

extern uint8_t T2__RECIPIENT_ID[];
extern uint8_t T2__RECIPIENT_ID_LEN;

extern uint8_t T2__MASTER_SALT[];
extern uint8_t T2__MASTER_SALT_LEN;

extern uint8_t* T2__ID_CONTEXT;
extern uint8_t T2__ID_CONTEXT_LEN;

/*The OSCORE message created in C4 (35 Byte). Constructed from a CoAP request of length 22. This request contains no payload. The request contains only Uri-host (locahost) and Uri-path option (tv1). In the OSCORE packet Uri-host option is transferred as plain normal option, The Uri-path is contained in the ciphertext. */
extern uint8_t T2__OSCORE_REQ[];
extern uint8_t T2__OSCORE_REQ_LEN;

/*Unprotected CoAP response (21 bytes)*/
/*Contains the payload "Hello World!"*/
extern uint8_t T2__COAP_RESPONSE[];
extern uint8_t T2__COAP_RESPONSE_LEN;

/*Expected result*/
/*the  reconstructed coap request see Appendix C4*/
extern uint8_t T2__COAP_REQ[];
extern uint8_t T2__COAP_REQ_LEN;

extern uint8_t T2__OSCORE_RESP[];
extern uint8_t T2__OSCORE_RESP_LEN;

/**
 * Test 3:
 * - Client Key derivation without master salt see RFC8613 Appendix C.2.1
 * - Generating OSCORE request with key form C.2.1 see RFC8613 Appendix C.5 
 */
/*Test vector C2.1: Key derivation without Master Salt*/
extern uint8_t T3__MASTER_SECRET[16];
extern uint8_t T3__MASTER_SECRET_LEN;

extern uint8_t T3__SENDER_ID[1];
extern uint8_t T3__SENDER_ID_LEN;

extern uint8_t T3__RECIPIENT_ID[1];
extern uint8_t T3__RECIPIENT_ID_LEN;

extern uint8_t* T3__MASTER_SALT;
extern uint8_t T3__MASTER_SALT_LEN;

extern uint8_t* T3__ID_CONTEXT;
extern uint8_t T3__ID_CONTEXT_LEN;

/*Test vector C5: Generating a OSCORE Packet with key material form test vector C.2.1 */
extern uint8_t T3__COAP_REQ[];
extern uint16_t T3__COAP_REQ_LEN;

/*expected result*/
extern uint8_t T3__OSCORE_REQ[];
extern uint8_t T3__OSCORE_REQ_LEN;

/**
 * Test 4:
 * - Server Key derivation without master salt see RFC8613 Appendix C.2.2
 */
/*Test vector C2.2: Key derivation without Master Salt*/
extern uint8_t T4__MASTER_SECRET[16];
extern uint8_t T4__MASTER_SECRET_LEN;

extern uint8_t T4__SENDER_ID[1];
extern uint8_t T4__SENDER_ID_LEN;

extern uint8_t T4__RECIPIENT_ID[1];
extern uint8_t T4__RECIPIENT_ID_LEN;

extern uint8_t* T4__MASTER_SALT;
extern uint8_t T4__MASTER_SALT_LEN;

extern uint8_t* T4__ID_CONTEXT;
extern uint8_t T4__ID_CONTEXT_LEN;

/*expected result*/
extern uint8_t T4__SENDER_KEY[];
extern uint8_t T4__SENDER_KEY_LEN;

extern uint8_t T4__RECIPIENT_KEY[];
extern uint8_t T4__RECIPIENT_KEY_LEN;

extern uint8_t T4__COMMON_IV[];
extern uint8_t T4__COMMON_IV_LEN;

/**
 * Test 5 :
 * - Client Key derivation with ID Context see Appendix 3.1
 * - OSCORE request generation see Appendix C6
 */
/*Test vector C3.1: Key derivation with ID Context*/
extern uint8_t T5__MASTER_SECRET[16];
extern uint8_t T5__MASTER_SECRET_LEN;

extern uint8_t* T5__SENDER_ID;
extern uint8_t T5__SENDER_ID_LEN;

extern uint8_t T5__RECIPIENT_ID[1];
extern uint8_t T5__RECIPIENT_ID_LEN;

extern uint8_t T5__MASTER_SALT[8];
extern uint8_t T5__MASTER_SALT_LEN;

extern uint8_t T5__ID_CONTEXT[8];
extern uint8_t T5__ID_CONTEXT_LEN;

/*Test vector C6: Generating a OSCORE Packet with key material form test vector C.3.1 */
extern uint8_t T5__COAP_REQ[];
extern uint16_t T5__COAP_REQ_LEN;

/*Expected result*/
extern uint8_t T5__OSCORE_REQ[];
extern uint8_t T5__OSCORE_REQ_LEN;

/**
 * Test 6:
 * - Server Key derivation with ID context see RFC8613 Appendix C.3.2
 */
extern uint8_t T6__MASTER_SECRET[16];
extern uint8_t T6__MASTER_SECRET_LEN;

extern uint8_t T6__SENDER_ID[1];
extern uint8_t T6__SENDER_ID_LEN;

extern uint8_t* T6__RECIPIENT_ID;
extern uint8_t T6__RECIPIENT_ID_LEN;

extern uint8_t T6__MASTER_SALT[8];
extern uint8_t T6__MASTER_SALT_LEN;

extern uint8_t T6__ID_CONTEXT[8];
extern uint8_t T6__ID_CONTEXT_LEN;

/*expected result*/
extern uint8_t T6__SENDER_KEY[];
extern uint8_t T6__SENDER_KEY_LEN;

extern uint8_t T6__RECIPIENT_KEY[];
extern uint8_t T6__RECIPIENT_KEY_LEN;

extern uint8_t T6__COMMON_IV[];
extern uint8_t T6__COMMON_IV_LEN;

/**
 * Test 7:
 * - Server with partial IV see Appendix C8
 */
extern uint8_t T7__MASTER_SECRET[16];
extern uint8_t T7__MASTER_SECRET_LEN;

extern uint8_t T7__SENDER_ID[];
extern uint8_t T7__SENDER_ID_LEN;

extern uint8_t* T7__RECIPIENT_ID;
extern uint8_t T7__RECIPIENT_ID_LEN;

extern uint8_t T7__MASTER_SALT[8];
extern uint8_t T7__MASTER_SALT_LEN;

extern uint8_t* T7__ID_CONTEXT;
extern uint8_t T7__ID_CONTEXT_LEN;

/*Test vector C4: Generating a OSCORE Packet with key material form test vector C.1 */
/*the OSCORE message created in C4*/
extern uint8_t T7__OSCORE_REQ[];
extern uint8_t T7__OSCORE_REQ_LEN;

/*unprotected CoAP response*/
extern uint8_t T7__COAP_RESPONSE[];
extern uint8_t T7__COAP_RESPONSE_LEN;

/*expected result*/
extern uint8_t T7__OSCORE_RES[];
extern uint8_t T7__OSCORE_RES_LEN;

#endif
```

## src/txrx_wrapper.c
```c
/*
   Copyright (c) 2021 Fraunhofer AISEC. See the COPYRIGHT
   file at the top-level directory of this distribution.

   Licensed under the Apache License, Version 2.0 <LICENSE-APACHE or
   http://www.apache.org/licenses/LICENSE-2.0> or the MIT license
   <LICENSE-MIT or http://opensource.org/licenses/MIT>, at your
   option. This file may not be copied, modified, or distributed
   except according to those terms.
*/

#include <edhoc.h>
#include <stdbool.h>
#include <string.h>
#include "edhoc_tests.h"
bool rx_initiator_switch = false;

/**
 * memcpy_s (see [1]) may not be available in some setups thus our own 
 * implementation 
 * [1]: https://docs.microsoft.com/de-de/cpp/c-runtime-library/reference/memcpy-s-wmemcpy-s?view=msvc-160
 */
static int _memcpy_s(uint8_t *dest, uint32_t destSize, const uint8_t *src,
		     uint8_t count)
{
	if (destSize < count) {
		return -1;
	} else {
		memcpy(dest, src, count);
	}
	return 0;
}

static uint8_t msg_cnt;

void rx_init(void)
{
	msg_cnt = 1;
}

enum err rx(uint8_t *data, uint32_t *data_len)
{
	if (rx_initiator_switch) {
		PRINTF("TXRX wrapper test vectors\n");
		/*The initiator must get msg2 and msg4*/
		if (msg_cnt == 1) {
			/*message 2*/
			TRY(_memcpy_s(data, *data_len, m.m2.ptr, m.m2.len));
			*data_len = m.m2.len;
			msg_cnt++;
		} else {
			/*message 4*/
			TRY(_memcpy_s(data, *data_len, m.m4.ptr, m.m4.len));
			*data_len = m.m4.len;
			msg_cnt = 1;
		}
	} else {
		PRINTF("TXRX wrapper test vectors\n");

		/*The responder must get msg1 and msg3*/
		if (msg_cnt == 1) {
			/*message 1 */
			TRY(_memcpy_s(data, *data_len, m.m1.ptr, m.m1.len));
			*data_len = m.m1.len;
			msg_cnt++;
		} else {
			/*message 3*/
			TRY(_memcpy_s(data, *data_len, m.m3.ptr, m.m3.len));
			*data_len = m.m3.len;
			msg_cnt = 1;
		}
	}
	return edhoc_no_error;
}

enum err tx(uint8_t *data, uint32_t data_len)
{ //todo add here a test
	return edhoc_no_error;
}
```

## src/txrx_wrapper.h
```c
/*
   Copyright (c) 2021 Fraunhofer AISEC. See the COPYRIGHT
   file at the top-level directory of this distribution.

   Licensed under the Apache License, Version 2.0 <LICENSE-APACHE or
   http://www.apache.org/licenses/LICENSE-2.0> or the MIT license
   <LICENSE-MIT or http://opensource.org/licenses/MIT>, at your
   option. This file may not be copied, modified, or distributed
   except according to those terms.
*/

#ifndef TXRX_WRAPPER_H
#define TXRX_WRAPPER_H
#include <edhoc.h>

extern bool rx_initiator_switch;
enum err rx(uint8_t *data, uint32_t *data_len);
enum err tx(uint8_t *data, uint32_t data_len);
void rx_init(void);
#endif
```
